## Linux/buildroot/configs/KTKick_defconfig
```kconfig
BR2_aarch64=y
BR2_TOOLCHAIN_EXTERNAL=y
BR2_TOOLCHAIN_EXTERNAL_GDB_SERVER_COPY=y
BR2_TARGET_GENERIC_ISSUE="Kick"
BR2_INIT_SYSTEMD=y
BR2_TARGET_GENERIC_GETTY_PORT="ttymxc3"
BR2_SYSTEM_DEFAULT_PATH="/bin:/sbin:/usr/bin:/usr/sbin"
BR2_ROOTFS_OVERLAY="board/freescale/imx8mm_var_som/rootfs_overlay"
BR2_ROOTFS_POST_IMAGE_SCRIPT="board/freescale/imx8mm_var_som/imx8-bootloader-prepare.sh board/freescale/imx8mm_var_som/post-image.sh"
BR2_ROOTFS_POST_SCRIPT_ARGS="${UBOOT_DIR}/arch/arm/dts"
BR2_LINUX_KERNEL=y
BR2_LINUX_KERNEL_CUSTOM_GIT=y
BR2_LINUX_KERNEL_CUSTOM_REPO_URL="https://github.com/varigit/linux-imx.git"
BR2_LINUX_KERNEL_CUSTOM_REPO_VERSION="920c302cfe05d805f97be9635af411e67c888051"
BR2_LINUX_KERNEL_PATCH="board/freescale/imx8mm_var_som/patches/linux/"
BR2_LINUX_KERNEL_USE_CUSTOM_CONFIG=y
BR2_LINUX_KERNEL_CUSTOM_CONFIG_FILE="board/freescale/imx8mm_var_som/linux-configs/Linux-defconfig"
BR2_LINUX_KERNEL_CUSTOM_LOGO_PATH="board/freescale/imx8mm_var_som/Logo.png"
BR2_LINUX_KERNEL_IMAGEGZ=y
BR2_LINUX_KERNEL_DTS_SUPPORT=y
BR2_LINUX_KERNEL_INTREE_DTS_NAME="freescale/imx8mm-var-som-symphony freescale/imx8mm-var-som-symphony-legacy freescale/imx8mm-var-som-symphony-legacy-m4 freescale/imx8mm-var-som-symphony-m4"
BR2_LINUX_KERNEL_NEEDS_HOST_OPENSSL=y
BR2_PACKAGE_ALSA_UTILS=y
BR2_PACKAGE_ALSA_UTILS_ALSACONF=y
BR2_PACKAGE_ALSA_UTILS_ACONNECT=y
BR2_PACKAGE_ALSA_UTILS_AMIXER=y
BR2_PACKAGE_ALSA_UTILS_APLAY=y
BR2_PACKAGE_ALSA_UTILS_APLAYMIDI=y
BR2_PACKAGE_ALSA_UTILS_SPEAKER_TEST=y
BR2_PACKAGE_ATEST=y
BR2_PACKAGE_FFMPEG=y
BR2_PACKAGE_FFMPEG_AVRESAMPLE=y
BR2_PACKAGE_FFMPEG_SWSCALE=y
BR2_PACKAGE_FLAC=y
BR2_PACKAGE_JACK2=y
BR2_PACKAGE_MADPLAY=y
BR2_PACKAGE_DOSFSTOOLS=y
BR2_PACKAGE_DOSFSTOOLS_FATLABEL=y
BR2_PACKAGE_DOSFSTOOLS_FSCK_FAT=y
BR2_PACKAGE_DOSFSTOOLS_MKFS_FAT=y
BR2_PACKAGE_MMC_UTILS=y
BR2_PACKAGE_MTD=y
BR2_PACKAGE_MTD_MKFSJFFS2=y
BR2_PACKAGE_MTD_MTDPART=y
BR2_PACKAGE_MTD_TESTS=y
BR2_PACKAGE_SQUASHFS=y
BR2_PACKAGE_SQUASHFS_LZ4=y
BR2_PACKAGE_SQUASHFS_LZMA=y
BR2_PACKAGE_SQUASHFS_LZO=y
BR2_PACKAGE_SQUASHFS_XZ=y
BR2_PACKAGE_SQUASHFS_ZSTD=y
BR2_PACKAGE_DEJAVU=y
BR2_PACKAGE_WESTON=y
BR2_PACKAGE_WESTON_DEFAULT_DRM=y
BR2_PACKAGE_WESTON_X11=y
BR2_PACKAGE_WESTON_XWAYLAND=y
BR2_PACKAGE_WESTON_DEMO_CLIENTS=y
BR2_PACKAGE_XORG7=y
BR2_PACKAGE_XSERVER_XORG_SERVER=y
BR2_PACKAGE_XCB_UTIL_CURSOR=y
BR2_PACKAGE_XCB_UTIL_KEYSYMS=y
BR2_PACKAGE_XCB_UTIL_WM=y
BR2_PACKAGE_XLIB_LIBFS=y
BR2_PACKAGE_XLIB_LIBXSCRNSAVER=y
BR2_PACKAGE_XLIB_LIBXCOMPOSITE=y
BR2_PACKAGE_XLIB_LIBXFONT=y
BR2_PACKAGE_XLIB_LIBXTST=y
BR2_PACKAGE_XLIB_LIBXVMC=y
BR2_PACKAGE_XLIB_LIBXXF86DGA=y
BR2_PACKAGE_XLIB_LIBDMX=y
BR2_PACKAGE_XDRIVER_XF86_INPUT_LIBINPUT=y
BR2_PACKAGE_XDRIVER_XF86_INPUT_SYNAPTICS=y
BR2_PACKAGE_XDRIVER_XF86_VIDEO_FBDEV=y
BR2_PACKAGE_XDRIVER_XF86_VIDEO_FBTURBO=y
BR2_PACKAGE_XDATA_XCURSOR_THEMES=y
BR2_PACKAGE_XCURSOR_TRANSPARENT_THEME=y
BR2_PACKAGE_FEH=y
BR2_PACKAGE_XTERM=y
BR2_PACKAGE_LINUX_FIRMWARE=y
BR2_PACKAGE_LINUX_FIRMWARE_BRCM_BCM43XX=y
BR2_PACKAGE_LINUX_FIRMWARE_BRCM_BCM43XXX=y
BR2_PACKAGE_FREESCALE_IMX=y
BR2_PACKAGE_FREESCALE_IMX_PLATFORM_IMX8MM=y
BR2_PACKAGE_IMX_CODEC=y
BR2_PACKAGE_IMX_PARSER=y
BR2_PACKAGE_FIRMWARE_IMX=y
BR2_PACKAGE_FIRMWARE_IMX_DMEM_LEN=0x1000
BR2_PACKAGE_IMX_GPU_G2D=y
BR2_PACKAGE_IMX_GPU_G2D_EXAMPLES=y
BR2_PACKAGE_IMX_GPU_VIV_OUTPUT_WL=y
BR2_PACKAGE_KERNEL_MODULE_IMX_GPU_VIV=y
BR2_PACKAGE_LIBUBOOTENV=y
BR2_PACKAGE_TAGLIB=y
BR2_PACKAGE_OPENSSL=y
BR2_PACKAGE_SQLITE=y
BR2_PACKAGE_SQLITE_ENABLE_COLUMN_METADATA=y
BR2_PACKAGE_CAIRO_PS=y
BR2_PACKAGE_CAIRO_SCRIPT=y
BR2_PACKAGE_CAIRO_SVG=y
BR2_PACKAGE_CAIRO_TEE=y
BR2_PACKAGE_CAIRO_XML=y
BR2_PACKAGE_LIBEPOXY=y
BR2_PACKAGE_PANGOMM=y
BR2_PACKAGE_WAYLAND_UTILS=y
BR2_PACKAGE_LIBSERIAL=y
BR2_PACKAGE_LIBSERIALPORT=y
BR2_PACKAGE_LIBCURL=y
BR2_PACKAGE_LIBNL=y
BR2_PACKAGE_LIBUEV=y
BR2_PACKAGE_LINUX_PAM=y
BR2_PACKAGE_PCRE2=y
BR2_PACKAGE_PCRE2_16=y
BR2_PACKAGE_CANNELLONI=y
BR2_PACKAGE_DHCP=y
BR2_PACKAGE_DHCP_CLIENT=y
BR2_PACKAGE_DHCPCD=y
BR2_PACKAGE_DROPBEAR=y
BR2_PACKAGE_SWUPDATE=y
BR2_PACKAGE_SYSTEMD_LOGIND=y
BR2_PACKAGE_NANO=y
BR2_PACKAGE_KICK_CAMERA=y
BR2_PACKAGE_KICK_GESTURE=y
BR2_TARGET_ROOTFS_EXT2=y
BR2_TARGET_ROOTFS_EXT2_4=y
BR2_TARGET_ROOTFS_EXT2_SIZE="762M"
BR2_TARGET_ROOTFS_SQUASHFS=y
BR2_TARGET_ARM_TRUSTED_FIRMWARE=y
BR2_TARGET_ARM_TRUSTED_FIRMWARE_CUSTOM_GIT=y
BR2_TARGET_ARM_TRUSTED_FIRMWARE_CUSTOM_REPO_URL="git://github.com/varigit/imx-atf"
BR2_TARGET_ARM_TRUSTED_FIRMWARE_CUSTOM_REPO_VERSION="e5884084510a2a88101351bed3710860c28c0657"
BR2_TARGET_ARM_TRUSTED_FIRMWARE_PLATFORM="imx8mm"
BR2_TARGET_ARM_TRUSTED_FIRMWARE_BL31=y
BR2_TARGET_UBOOT=y
BR2_TARGET_UBOOT_BUILD_SYSTEM_KCONFIG=y
BR2_TARGET_UBOOT_CUSTOM_GIT=y
BR2_TARGET_UBOOT_CUSTOM_REPO_URL="https://github.com/varigit/uboot-imx.git"
BR2_TARGET_UBOOT_CUSTOM_REPO_VERSION="46d384f517a2dbe63c6161d2ecfd964fdc08bf89"
BR2_TARGET_UBOOT_PATCH="board/freescale/imx8mm_var_som/patches/u-boot"
BR2_TARGET_UBOOT_USE_CUSTOM_CONFIG=y
BR2_TARGET_UBOOT_CUSTOM_CONFIG_FILE="board/freescale/imx8mm_var_som/u-boot/imx8mm_var_dart_defconfig"
BR2_TARGET_UBOOT_NEEDS_DTC=y
BR2_TARGET_UBOOT_FORMAT_CUSTOM=y
BR2_TARGET_UBOOT_FORMAT_CUSTOM_NAME="u-boot-nodtb.bin"
BR2_TARGET_UBOOT_SPL=y
BR2_PACKAGE_HOST_DOSFSTOOLS=y
BR2_PACKAGE_HOST_GENIMAGE=y
BR2_PACKAGE_HOST_IMX_MKIMAGE=y
BR2_PACKAGE_HOST_MTOOLS=y
BR2_PACKAGE_HOST_UBOOT_TOOLS=y
BR2_PACKAGE_HOST_UBOOT_TOOLS_FIT_SUPPORT=y
```

## Linux/buildroot/package/kick-camera/Config.in
```kconfig
# SPDX-License-Identifier: AGPL-3.0-or-later
config BR2_PACKAGE_KICK_CAMERA
	bool "kick-camera"
	depends on BR2_INSTALL_LIBSTDCPP
	depends on BR2_TOOLCHAIN_HAS_THREADS
	help
	  Camera capture service for the Kick. Captures frames from a
	  V4L2 device (the MIPI CSI sensor or a USB webcam) and shares
	  them with other processes through POSIX shared memory.

	  The camera stays closed until a client sends "enable" on the
	  control socket. The service has no network access and writes no
	  frames to disk unless a debug option is set.

	  It is plain C++17 with no dependencies beyond the C and C++
	  libraries, and installs one binary, a config file and a systemd
	  unit. The unit is only installed and enabled when the init
	  system is systemd.

	  Source: Kick/services/kick_camera in this repository.

comment "kick-camera needs a toolchain w/ C++ and threads"
	depends on !BR2_INSTALL_LIBSTDCPP || !BR2_TOOLCHAIN_HAS_THREADS
```

## Linux/buildroot/package/kick-gesture/Config.in
```kconfig
# SPDX-License-Identifier: AGPL-3.0-or-later
config BR2_PACKAGE_KICK_GESTURE
	bool "kick-gesture"
	depends on BR2_INSTALL_LIBSTDCPP
	depends on BR2_TOOLCHAIN_HAS_THREADS
	depends on BR2_TOOLCHAIN_USES_GLIBC
	depends on BR2_aarch64 || BR2_x86_64
	depends on BR2_PACKAGE_KICK_CAMERA
	help
	  Hand gesture recognition service for the Kick. It reads the
	  frames the kick-camera service publishes in shared memory,
	  finds a hand with two small neural networks (MediaPipe palm
	  detection and hand landmark, run by ONNX Runtime), and turns
	  the landmark stream into discrete events: swipe left and right,
	  palm hold, fist, and pinch start, change and end. The events
	  leave on a Unix socket as one JSON object per line. No image
	  is stored and the service has no network access.

	  It does no work while the camera is off, and it halves its rate
	  or stops when the CPU or the board runs hot.

	  The ONNX Runtime prebuilt archive and the model files are
	  downloaded by Buildroot as extra downloads and checked against
	  the hashes in kick-gesture.hash. They are never committed. The
	  ONNX Runtime archive is built against glibc, so a musl or
	  uClibc toolchain cannot use it.

	  Source: Kick/services/kick_gesture in this repository.

comment "kick-gesture needs kick-camera and a glibc toolchain w/ C++ and threads"
	depends on BR2_aarch64 || BR2_x86_64
	depends on !BR2_INSTALL_LIBSTDCPP || !BR2_TOOLCHAIN_HAS_THREADS \
		|| !BR2_TOOLCHAIN_USES_GLIBC || !BR2_PACKAGE_KICK_CAMERA
```
